/dts-v1/;
/plugin/;
/ {
	fragment {
		target-path = "/";
		__overlay__ {
			#address-cells = <1>;
			mydevice@3 {
				compatible = "test,mydriver1";
				reg = <0x2000 0x0100>,<0x4000 0x0200>;
			};
		};
	};
};
