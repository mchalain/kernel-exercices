/dts-v1/;
/plugin/;
/ {
	fragment@0 {
		target-path = "/";
		__overlay__ {
			#address-cells = <2>;
			#size-cells = <1>;
			mydevice@2.2 {
				compatible = "example,mydriver1";
				reg = <0x0001 0x70000000 0x10000000>;
			};
		};
	};
};
