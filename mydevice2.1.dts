/dts-v1/;
/plugin/;
/ {
	fragment@0 {
		target-path = "/";
		__overlay__ {
			#address-cells = <1>;
			#size-cells = <0>;
			mydevice@2.1 {
				compatible = "example,mydriver1";
				reg = <2>;
			};
		};
	};
};
